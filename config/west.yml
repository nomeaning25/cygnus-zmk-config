## config/west.yml
```yaml
manifest:
  remotes:
    - name: rafaelromao
      url-base: https://github.com/rafaelromao
    - name: zmkfirmware
      url-base: https://github.com/zmkfirmware
    - name: englmaxi
      url-base: https://github.com/englmaxi
  projects:
    - name: zmk
      remote: rafaelromao
      revision: 20240328/rafaelromao/main
      import: app/west.yml
    - name: zmk-dongle-display
      remote: englmaxi
      revision: main
  self:
    path: config
```
